## buildroot-external/Config.in
```kconfig
menu "AI Model Builder OS"

source "$BR2_EXTERNAL_AIBUILDER_PATH/package/aibuilder/Config.in"

endmenu
```

## buildroot-external/package/aibuilder/Config.in
```kconfig
config BR2_PACKAGE_AIBUILDER
	bool "AI Model Builder node tools"
	select BR2_PACKAGE_PYTHON3
	help
	  Install the local, read-only hardware capability inventory tools
	  and the capability JSON schema. This package does not start an
	  AI training service or modify storage.
```
